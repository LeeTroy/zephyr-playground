## west.yml
```yaml
manifest:
  defaults:
    remote: upstream

  remotes:
    - name: upstream
      url-base: https://github.com/aspeedtech-bmc

  projects:
    - name: zephyr
      revision: HEAD
      import:
        name-whitelist:
          - mcumgr
          - cmsis
          - mcuboot
          - mbedtls
```
